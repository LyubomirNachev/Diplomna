## sample.yaml
```
sample:
  name: OpenThread CLI sample
  description: Test OpenThread Command Line Interface.
tests:
  sample.openthread.cli:
    build_only: true
    platform_allow: nrf5340dk_nrf5340_cpuapp nrf5340dk_nrf5340_cpuapp_ns nrf52840dk_nrf52840 nrf21540dk_nrf52840
    tags: ci_build
    extra_args: OVERLAY_CONFIG=overlay-ci.conf;overlay-multiprotocol.conf
    integration_platforms:
      - nrf5340dk_nrf5340_cpuapp
      - nrf5340dk_nrf5340_cpuapp_ns
      - nrf52840dk_nrf52840
      - nrf21540dk_nrf52840
  sample.openthread.cli_hadron:
    build_only: true
    platform_allow: nrf52833dk_nrf52833
    tags: ci_build
    extra_args: OVERLAY_CONFIG=overlay-ci.conf
    integration_platforms:
      - nrf52833dk_nrf52833
  sample.openthread.cli.thread_1_1:
    build_only: true
    platform_allow: nrf5340dk_nrf5340_cpuapp nrf5340dk_nrf5340_cpuapp_ns nrf52840dk_nrf52840 nrf21540dk_nrf52840
    tags: ci_build
    extra_args: CONFIG_OPENTHREAD_THREAD_VERSION_1_1=y
                OVERLAY_CONFIG=overlay-ci.conf;overlay-multiprotocol.conf
    integration_platforms:
      - nrf5340dk_nrf5340_cpuapp
      - nrf5340dk_nrf5340_cpuapp_ns
      - nrf52840dk_nrf52840
      - nrf21540dk_nrf52840
  sample.openthread.cli.usb:
    build_only: true
    platform_allow: nrf5340dk_nrf5340_cpuapp nrf5340dk_nrf5340_cpuapp_ns nrf52840dk_nrf52840 nrf52840dongle_nrf52840 nrf21540dk_nrf52840
    tags: ci_build
    extra_args: OVERLAY_CONFIG=overlay-usb.conf;overlay-ci.conf;overlay-multiprotocol.conf
                DTC_OVERLAY_FILE=usb.overlay
    integration_platforms:
      - nrf5340dk_nrf5340_cpuapp
      - nrf5340dk_nrf5340_cpuapp_ns
      - nrf52840dk_nrf52840
      - nrf52840dongle_nrf52840
      - nrf21540dk_nrf52840
  # Build integration regression protection.
  sample.nrf_security.openthread.integration:
      build_only: True
      extra_args: CONFIG_NRF_SECURITY=y
      platform_allow: nrf5340dk_nrf5340_cpuapp_ns nrf52840dk_nrf52840
      integration_platforms:
          - nrf5340dk_nrf5340_cpuapp_ns
          - nrf52840dk_nrf52840
  sample.usb.console:
    depends_on: usb_device usb_cdc
    tags: usb
    platform_exclude: native_posix native_posix_64
    harness: console
    harness_config:
      fixture: fixture_usb_cdc
```

## prj.conf
```kconfig
# Network shell
CONFIG_SHELL=y
CONFIG_OPENTHREAD_SHELL=y
CONFIG_SHELL_ARGC_MAX=26
CONFIG_SHELL_CMD_BUFF_SIZE=416

# Enable OpenThread features set
CONFIG_OPENTHREAD_NORDIC_LIBRARY_MASTER=y
CONFIG_NET_L2_OPENTHREAD=y

# Generic networking options
CONFIG_NETWORKING=y
CONFIG_ASSERT=y
CONFIG_ASSERT_NO_COND_INFO=y
CONFIG_MBEDTLS_SHA1_C=n
CONFIG_FPU=y
CONFIG_GPIO_SHELL=y

# Enable Zephyr logging
CONFIG_LOG=y

# Use printk to log messages
CONFIG_LOG_MODE_MINIMAL=y

# Log only errors/hard faults
CONFIG_LOG_MAX_LEVEL=1

CONFIG_OPENTHREAD_BORDER_ROUTER=y
CONFIG_OPENTHREAD_BACKBONE_ROUTER=y
CONFIG_OPENTHREAD_SRP_SERVER=y

CONFIG_NRF_802154_SOURCE_NRFXLIB=y
CONFIG_NRF_802154_RADIO_DRIVER=y

#Network parameter
CONFIG_OPENTHREAD_NORDIC_LIBRARY_FTD=y
CONFIG_OPENTHREAD_MANUAL_START=n
CONFIG_OPENTHREAD_NETWORK_NAME="OpenThread"
CONFIG_OPENTHREAD_PANID=7856
#CONFIG_OPENTHREAD_XPANID=""
CONFIG_OPENTHREAD_NETWORKKEY="20118159fbfbbe2146c05ad8e91dcf77"
```

## overlay-ci.conf
```kconfig
#
# Copyright (c) 2022 Nordic Semiconductor
#
# SPDX-License-Identifier: LicenseRef-Nordic-5-Clause
#

# Disable boot banner
CONFIG_BOOT_BANNER=y

# Shell configuration for CI
CONFIG_SHELL_PROMPT_UART=""

CONFIG_SHELL_VT100_COLORS=y
CONFIG_SHELL_ECHO_STATUS=y
CONFIG_SHELL_DEFAULT_TERMINAL_HEIGHT=416
CONFIG_SHELL_DEFAULT_TERMINAL_WIDTH=800
```

## overlay-usb.conf
```kconfig
#
# Copyright (c) 2021 Nordic Semiconductor
#
# SPDX-License-Identifier: LicenseRef-Nordic-5-Clause
#

CONFIG_SHELL_BACKEND_SERIAL_INIT_PRIORITY=51

CONFIG_UART_LINE_CTRL=y
CONFIG_SHELL_BACKEND_SERIAL_CHECK_DTR=y
CONFIG_USB_CDC_ACM_LOG_LEVEL_OFF=n

CONFIG_USB_DEVICE_STACK=y
CONFIG_USB_DEVICE_REMOTE_WAKEUP=n
#CONFIG_USB_DEVICE_MANUFACTURER="Nordic Semiconductor ASA"
CONFIG_USB_DEVICE_PRODUCT="Thread CLI"
#CONFIG_USB_DEVICE_VID=0x1915
#CONFIG_USB_DEVICE_PID=0x0000
```

## usb.overlay
```dts
/ {
	chosen {
		zephyr,shell-uart = &cdc_acm_uart0;
	};
};

&zephyr_udc0 {
	cdc_acm_uart0: cdc_acm_uart0 {
		compatible = "zephyr,cdc-acm-uart";
		label = "CDC_ACM_0";
	};
};
```

## boards/nrf52840dongle_nrf52840.overlay
```dts
&uart0 {
	status = "okay";
	hw-flow-control;
};

/ {
	chosen {
		zephyr,entropy = &rng;
	};
};
```

## src/main.c
```c
#include <zephyr.h>
#include <device.h>
#include <devicetree.h>
#include <drivers/gpio.h>
#include <zephyr/kernel.h>
#include <zephyr/drivers/uart.h>
#include <zephyr/usb/usb_device.h>
#include <openthread/thread.h>
#include <net/openthread.h>

#include <zephyr/logging/log.h>
#include <openthread/udp.h>

LOG_MODULE_REGISTER(cli_sample, CONFIG_OT_COMMAND_LINE_INTERFACE_LOG_LEVEL);

static const struct gpio_dt_spec button0_spec = GPIO_DT_SPEC_GET(DT_NODELABEL(button0), gpios);
static struct gpio_callback button0_cb;

static void udp_send(void){
	otError	error = OT_ERROR_NONE;
	const char *buf = "Hello Thread"; 
	otInstance *myInstance; 
	myInstance = openthread_get_default_instance(); 
	otUdpSocket mySocket; 

	otMessageInfo messageInfo;
	memset(&messageInfo, 0, sizeof(messageInfo)); 
	otIp6AddressFromString("ff03::1", &messageInfo.mPeerAddr); 
	messageInfo.mPeerPort = 12346;

	do{
		error = otUdpOpen(myInstance, &mySocket, NULL, NULL);
		if (error != OT_ERROR_NONE){ break; }
		otMessage *test_Message = otUdpNewMessage(myInstance, NULL);
		error = otMessageAppend(test_Message, buf, (uint16_t)strlen(buf));  
		if (error != OT_ERROR_NONE){ break; }
		error = otUdpSend(myInstance, &mySocket, test_Message, &messageInfo);
		if (error != OT_ERROR_NONE){ break; }
		error = otUdpClose(myInstance, &mySocket); 
	}while(false);
	
	if(error == OT_ERROR_NONE){
		LOG_INF("Send.\n"); 
	}else{
		LOG_INF("udpSend error: %d\n", error); 
	}
}

void button_pressed_callback(const struct device *gpiob, struct gpio_callback *cb, gpio_port_pins_t pins){ 
	udp_send();
}

void main(void)
{
	gpio_pin_configure_dt(&button0_spec, GPIO_INPUT);
	gpio_pin_interrupt_configure_dt(&button0_spec, GPIO_INT_EDGE_TO_ACTIVE);
	gpio_init_callback(&button0_cb, button_pressed_callback, BIT(button0_spec.pin));
	gpio_add_callback(button0_spec.port, &button0_cb);


	otInstance *myInstance;
	myInstance = openthread_get_default_instance();
	otPlatRadioSetTransmitPower(myInstance, 8);
	int err = usb_enable(NULL);
	const struct device *dev;
	uint32_t dtr = 0;
 
	if (err != 0) {
		LOG_ERR("Failed to enable USB");
		return;
	}

	dev = DEVICE_DT_GET(DT_CHOSEN(zephyr_shell_uart));
	if (dev == NULL) {
		LOG_ERR("Failed to find specific UART device");
		return;
	}

	/* Data Terminal Ready - check if host is ready to communicate */
	while (!dtr) {
		err = uart_line_ctrl_get(dev, UART_LINE_CTRL_DTR, &dtr);
		if (err) {
			LOG_ERR("Failed to get Data Terminal Ready line state: %d", err);
			continue;
		}
		k_msleep(100);
	}
}



















// static void udp_send(void){
// 	otError			error = OT_ERROR_NONE;
// 	const char *buf = "Hello Thread"; // буфер от символи, съдържащ данните, които ще бъдат изпратени

// 	otInstance *myInstance; // пойнтер към дефинираната OpenThread инстанция
// 	myInstance = openthread_get_default_instance(); // задаване на основната Openthread инстанция
// 	otUdpSocket mySocket; // структура, репрезентираща UDP цокълът

// 	otMessageInfo messageInfo; // структура, репрезентираща локалният и peer IPv6 адрес на цокъла
// 	memset(&messageInfo, 0, sizeof(messageInfo)); // подсигуряване, че messageInfo структурата ще бъде празна
// 	otIp6AddressFromString("ff03::1", &messageInfo.mPeerAddr); // преобразуване на IPv6 адреса в двоичен формат
// 	messageInfo.mPeerPort = 12346; // използваният udp port

// 	do{
// 		error = otUdpOpen(myInstance, &mySocket, NULL, NULL); //отваряне на UDP цокъла
// 		if (error != OT_ERROR_NONE){ break; }
// 		otMessage *test_Message = otUdpNewMessage(myInstance, NULL); // създаване на UDP съобщение

// 		// добавяне на байтовете от буфера съдържащ информацията към otMessage
// 		error = otMessageAppend(test_Message, buf, (uint16_t)strlen(buf));  
// 		if (error != OT_ERROR_NONE){ break; }
// 		error = otUdpSend(myInstance, &mySocket, test_Message, &messageInfo); // изпращане на otMessage съобщението
// 		if (error != OT_ERROR_NONE){ break; }
// 		error = otUdpClose(myInstance, &mySocket); // затваряне на UDP цокъла
// 	}while(false); // цикълът подсигурява, че при грешка изпълнението ще бъде прекъснато
	
// 	if(error == OT_ERROR_NONE){
// 		LOG_INF("Send.\n"); //съобщение за успешно изпращане
// 	}else{
// 		LOG_INF("udpSend error: %d\n", error); //съобщение за грешка
// 	}
// }

// // функция, проверяваща дали е натиснат бутона
// void button_pressed_callback(const struct device *gpiob, struct gpio_callback *cb, gpio_port_pins_t pins){ 
// 	udp_send(); //изпращане на данни 
// }

// void main(void)
// {
// 	// конфигурация на бутона 
// 	gpio_pin_configure_dt(&button0_spec, GPIO_INPUT);
// 	gpio_pin_interrupt_configure_dt(&button0_spec, GPIO_INT_EDGE_TO_ACTIVE);
// 	gpio_init_callback(&button0_cb, button_pressed_callback, BIT(button0_spec.pin));
// 	gpio_add_callback(button0_spec.port, &button0_cb);
// 	//

// 	int err = usb_enable(NULL); // 
// 	const struct device *dev;
// 	uint32_t dtr = 0;
 
// 	if (err != 0) {
// 		LOG_ERR("Failed to enable USB");
// 		return;
// 	}

// 	dev = DEVICE_DT_GET(DT_CHOSEN(zephyr_shell_uart));
// 	if (dev == NULL) {
// 		LOG_ERR("Failed to find specific UART device");
// 		return;
// 	}

// 	LOG_INF("Waiting for host to be ready to communicate");

// 	/* Data Terminal Ready - check if host is ready to communicate */
// 	while (!dtr) {
// 		err = uart_line_ctrl_get(dev, UART_LINE_CTRL_DTR, &dtr);
// 		if (err) {
// 			LOG_ERR("Failed to get Data Terminal Ready line state: %d", err);
// 			continue;
// 		}
// 		k_msleep(100);
// 	}

// }
```
