## sample.yaml
```
sample:
  name: OpenThread CLI sample
  description: Test OpenThread Command Line Interface.
tests:
  sample.openthread.cli.usb:
    build_only: true
    platform_allow: nrf52840dongle_nrf52840
    tags: ci_build
    extra_args: OVERLAY_CONFIG=overlay-usb.conf;overlay-ci.conf;overlay-multiprotocol.conf
                DTC_OVERLAY_FILE=usb.overlay
    integration_platforms:
      - nrf52840dongle_nrf52840
  sample.usb.console:
    depends_on: usb_device usb_cdc
    tags: usb
    platform_exclude: native_posix native_posix_64
    harness: console
    harness_config:
      fixture: fixture_usb_cdc
```

## prj.conf
```kconfig
# Network shell
CONFIG_SHELL=y
CONFIG_OPENTHREAD_SHELL=y
CONFIG_SHELL_ARGC_MAX=26
CONFIG_SHELL_CMD_BUFF_SIZE=416

# Enable OpenThread features set
CONFIG_OPENTHREAD_NORDIC_LIBRARY_MASTER=y
CONFIG_NET_L2_OPENTHREAD=y

# Generic networking options
CONFIG_NETWORKING=y
CONFIG_ASSERT=y
CONFIG_ASSERT_NO_COND_INFO=y
CONFIG_MBEDTLS_SHA1_C=n
CONFIG_FPU=y
CONFIG_GPIO_SHELL=y

# Enable Zephyr logging
CONFIG_LOG=y

# Use printk to log messages
CONFIG_LOG_MODE_MINIMAL=y

# Log only errors/hard faults
CONFIG_LOG_MAX_LEVEL=1

CONFIG_OPENTHREAD_BORDER_ROUTER=y
CONFIG_OPENTHREAD_BACKBONE_ROUTER=y
CONFIG_OPENTHREAD_SRP_SERVER=y

CONFIG_NRF_802154_SOURCE_NRFXLIB=y
CONFIG_NRF_802154_RADIO_DRIVER=y

#Network parameter
CONFIG_OPENTHREAD_NORDIC_LIBRARY_FTD=y
CONFIG_OPENTHREAD_MANUAL_START=n
CONFIG_OPENTHREAD_NETWORK_NAME="OpenThread"
CONFIG_OPENTHREAD_PANID=7856
#CONFIG_OPENTHREAD_XPANID=""
CONFIG_OPENTHREAD_NETWORKKEY="20118159fbfbbe2146c05ad8e91dcf77"
CONFIG_OPENTHREAD_PLATFORM_UDP=y
CONFIG_OPENTHREAD_UDP_FORWARD=y
```

## src/main.c
```c
#include <zephyr/kernel.h>
#include <zephyr/logging/log.h>
#include <zephyr/drivers/uart.h>
#include <zephyr/usb/usb_device.h>
#include <openthread/thread.h>
#include <net/openthread.h>
#include <openthread/udp.h>
#include <zephyr.h>
#include <device.h>
#include <devicetree.h>
#include <drivers/gpio.h>
#include <zephyr/sys/printk.h>

LOG_MODULE_REGISTER(cli_sample, CONFIG_OT_COMMAND_LINE_INTERFACE_LOG_LEVEL);

void udpReceiveCb(void *aContext, otMessage *aMessage, const otMessageInfo *aMessageInfo){
	uint16_t payloadLength = otMessageGetLength(aMessage) - otMessageGetOffset(aMessage);
	char buf[payloadLength+1];
	otMessageRead(aMessage, otMessageGetOffset(aMessage), buf, payloadLength);
	buf[payloadLength]='\0';
	//printk("Received: %s\n", buf);
	LOG_INF("Received: %s\n", buf);
}

static void udp_init(void){
	otError error = OT_ERROR_NONE;
	otInstance *myInstance = openthread_get_default_instance();
	otUdpSocket mySocket;
	otSockAddr mySockAddr;
	memset(&mySockAddr, 0, sizeof(mySockAddr));
	mySockAddr.mPort = 49155;

	do{
		error = otUdpOpen(myInstance, &mySocket, udpReceiveCb, NULL);
		if (error != OT_ERROR_NONE){break;}
		error = otUdpBind(myInstance, &mySocket, &mySockAddr, OT_NETIF_THREAD);
	}while(false);

	if(error != OT_ERROR_NONE){
		LOG_INF("init_udp error: %d\n", error);
	}
}



void main(void)
{
	udp_init();

	otPlatRadioSetTransmitPower(NULL, 8);
	int ret;
	const struct device *dev;
	uint32_t dtr = 0U;

	ret = usb_enable(NULL);
	if (ret != 0) {
		LOG_ERR("Failed to enable USB");
		return;
	}

	dev = DEVICE_DT_GET(DT_CHOSEN(zephyr_shell_uart));
	if (dev == NULL) {
		LOG_ERR("Failed to find specific UART device");
		return;
	}

	LOG_INF("Waiting for host to be ready to communicate");

	/* Data Terminal Ready - check if host is ready to communicate */
	while (!dtr) {
		ret = uart_line_ctrl_get(dev, UART_LINE_CTRL_DTR, &dtr);
		if (ret) {
			LOG_ERR("Failed to get Data Terminal Ready line state: %d",
				ret);
			continue;
		}
		k_msleep(100);
	}

	/* Data Carrier Detect Modem - mark connection as established */
	(void)uart_line_ctrl_set(dev, UART_LINE_CTRL_DCD, 1);
	/* Data Set Ready - the NCP SoC is ready to communicate */
	(void)uart_line_ctrl_set(dev, UART_LINE_CTRL_DSR, 1);
}
```
