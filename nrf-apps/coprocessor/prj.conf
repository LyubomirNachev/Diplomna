## sample.yaml
```
common:
  harness: net
  tags: net
  depends_on: netif
  min_flash: 140
sample:
  description: Runs the OpenThread stack as NCP BR
  name: OpenThread Network Co-Processor
tests:
  sample.net.openthread.coprocessor:
    build_only: true
    platform_allow: nrf52840dk_nrf52840 nrf52833dk_nrf52833 tlsr9518adk80d 
    tags: ci_build
  sample.net.openthread.coprocessor.usb:
    build_only: true
    platform_allow: nrf52840dk_nrf52840 nrf52833dk_nrf52833 
    tags: ci_build
    extra_args: OVERLAY_CONFIG=overlay-usb-nrf-br.conf
                DTC_OVERLAY_FILE="usb.overlay"
  sample.openthread.coprocessor.rcp:
    build_only: true
    platform_allow: nrf52840dk_nrf52840 nrf52833dk_nrf52833 tlsr9518adk80d nrf52840dongle_nrf52840
    tags: ci_build
    extra_args: OVERLAY_CONFIG=overlay-rcp.conf
```

## prj.conf
```kconfig
CONFIG_NETWORKING=y
CONFIG_NET_L2_OPENTHREAD=y

# Disable certain parts of Zephyr IPv6 stack
CONFIG_NET_IPV6_NBR_CACHE=n
CONFIG_NET_IPV6_MLD=n

# Logging
CONFIG_LOG=y
CONFIG_LOG_MAX_LEVEL=1
CONFIG_LOG_MODE_MINIMAL=n
CONFIG_LOG_BACKEND_SPINEL=y
CONFIG_BOOT_BANNER=n

# Kernel options
CONFIG_MAIN_STACK_SIZE=2560
CONFIG_INIT_STACKS=y

# Increase logging thread stack size due to Spinel backend needs
CONFIG_LOG_PROCESS_THREAD_STACK_SIZE=2048


CONFIG_OPENTHREAD_COPROCESSOR=y
CONFIG_ENTROPY_NRF5_RNG=y
```

## overlay-usb-nrf-br.conf
```kconfig
CONFIG_USB_DEVICE_STACK=y
CONFIG_USB_DEVICE_PRODUCT="OpenThread CoProcessor NRF"
CONFIG_USB_CDC_ACM=y
CONFIG_UART_LINE_CTRL=y
CONFIG_USB_REQUEST_BUFFER_SIZE=2048
CONFIG_ISR_STACK_SIZE=4096
```

## app.overlay
```dts
/ {
	chosen {
		zephyr,ot-uart = &uart0;
		zephyr,console = &uart1;
	};
};
```

## usb.overlay
```dts
/ {
	chosen {
		zephyr,ot-uart = &cdc_acm_uart0;
	};
};

&zephyr_udc0 {
	cdc_acm_uart0: cdc_acm_uart0 {
		compatible = "zephyr,cdc-acm-uart";
	};
};
```

## boards/nrf52840dongle_nrf52840.overlay
```dts
/ {
    chosen {
        zephyr,ot-uart = &uart0;
    };
};

/ {
    chosen {
        zephyr,entropy = &rng;
    };
};
```

## src/main.c
```c
#include <zephyr/logging/log.h>
LOG_MODULE_REGISTER(ot_br, LOG_LEVEL_DBG);
#define APP_BANNER "***** OpenThread NCP on Zephyr %s *****"

void main(void)
{
	LOG_INF(APP_BANNER, CONFIG_NET_SAMPLE_APPLICATION_VERSION);

}
```
